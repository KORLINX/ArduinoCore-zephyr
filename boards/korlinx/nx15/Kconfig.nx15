## boards/korlinx/nx15/Kconfig.nx15
```kconfig
# Copyright (c) 2026 Korlinx
# SPDX-License-Identifier: Apache-2.0

config BOARD_NX15
	select SOC_NRF54L15_CPUAPP if BOARD_NX15_NRF54L15_CPUAPP
```

## boards/korlinx/nx15/board.yml
```yaml
board:
  name: nx15
  full_name: Korlinx NX (nRF54L15)
  vendor: korlinx
  socs:
    - name: nrf54l15
```

## loader/Kconfig
```kconfig
#
# Copyright (c) Arduino s.r.l. and/or its affiliated companies
#
# SPDX-License-Identifier: Apache-2.0
#

config PINCTRL
	select PINCTRL_NON_STATIC

config USB_CONFIGURATION_STRING_DESC
	default "$(APP_VERSION_EXTENDED_STRING)"

config BOOT_BANNER_STRING
	default "Booting Arduino loader $(APP_VERSION_EXTENDED_STRING) on Zephyr OS build"

source "Kconfig.zephyr"

config LLEXT_HEAP_REGION
	string "LLEXT heap memory region"
	depends on CODE_DATA_RELOCATION
	help
	  Specify the memory region for LLEXT heap.

config MAIN_STACK_REGION
	string "Main stack memory region"
	depends on CODE_DATA_RELOCATION
	help
	  Specify the memory region for main stack.

rsource "ota/Kconfig"
```
